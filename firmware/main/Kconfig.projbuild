## firmware/main/Kconfig.projbuild
```kconfig
menu "M5Authenticator security"

choice M5AUTH_SECURITY_BACKEND
    prompt "Authenticator storage security backend"
    default M5AUTH_SECURITY_BACKEND_PRODUCTION

config M5AUTH_SECURITY_BACKEND_PRODUCTION
    bool "Production HMAC eFuse-backed NVS encryption"

config M5AUTH_SECURITY_BACKEND_DEV
    bool "Development synthetic NVS encryption"

endchoice

config M5AUTH_HMAC_KEY_ID
    int "HMAC eFuse key ID"
    range 0 5
    default 0
    depends on M5AUTH_SECURITY_BACKEND_PRODUCTION
    help
        Fixed HMAC key slot used by M5Authenticator. The firmware never searches
        for another HMAC_UP key automatically. A different slot must be selected
        intentionally after inspecting the device eFuse summary.

endmenu
```

## firmware/sdkconfig.defaults
```kconfig
CONFIG_ESP_CONSOLE_USB_SERIAL_JTAG=y
CONFIG_ESP_CONSOLE_SECONDARY_NONE=y
CONFIG_ESPTOOLPY_FLASHSIZE_8MB=y
CONFIG_PARTITION_TABLE_CUSTOM=y
CONFIG_PARTITION_TABLE_CUSTOM_FILENAME="partitions.csv"
CONFIG_PARTITION_TABLE_FILENAME="partitions.csv"
CONFIG_MBEDTLS_SHA1_C=y
CONFIG_MBEDTLS_HKDF_C=y
CONFIG_ESP_MAIN_TASK_STACK_SIZE=8192
CONFIG_ESP_COREDUMP_ENABLE_TO_NONE=y
```
